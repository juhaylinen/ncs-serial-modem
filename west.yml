## west.yml
```yaml
# Copyright (c) 2025 Nordic Semiconductor
# SPDX-License-Identifier: LicenseRef-Nordic-5-Clause

manifest:
  self:
    import: submanifests

  remotes:
    - name: ncs
      url-base: https://github.com/nrfconnect

  projects:
    - name: nrf
      remote: ncs
      repo-path: sdk-nrf
      revision: 0187e7cd26aaebd6eab1e1b9bbf814c769f8b11e
      import:
        name-allowlist:
          - cjson
          - cmsis_6
          - cmock
          - hal_nordic
          - libmodem
          - mbedtls
          - mcuboot
          - memfault-firmware-sdk
          - nrfxlib
          - oberon-psa-crypto
          - segger
          - trusted-firmware-m
          - zcbor
          - zephyr
```
